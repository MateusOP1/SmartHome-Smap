/* Projeto monitor de nivel app - Esp32, Firebase e app inventor
 *  
 * Autor - Mateus Oliveira de Paula
 * Data - 30/06/2022
 *
 */

#include <WiFiManager.h> 
#include <FirebaseESP32.h>
#include <Wire.h>
#include "Arduino.h"
#include "LoRa_E32.h"
//++++++++++++++++++++++++++++++
// Include libe Display Oled ssd1306
#include <Adafruit_GFX.h>
#include <Adafruit_SSD1306.h>
//++++++++++++++++++++++++++++++
//Difinicoes do display Oled
#define OLED_SDA_PIN    21
#define OLED_SCL_PIN    22
#define SCREEN_WIDTH    128 
#define SCREEN_HEIGHT   64  
#define OLED_ADDR       0x3C 
//++++++++++++++++++++++++++++++
#define OLED_LINE1     5
#define OLED_LINE2     15
#define OLED_LINE3     20
#define OLED_LINE4     30
#define OLED_LINE5     40
#define OLED_LINE6     50
//=======================================
#include "addons/TokenHelper.h"
#include "addons/RTDBHelper.h"

#define API_KEY "xxxxxxxxxxxxxxxxxxxxxxxxxxxxxxxxxxx"

#define DATABASE_URL "xxxxxxxxxxxxxxxxxxxxxxxxxxxxx" 

//Define Firebase Data object
FirebaseData fbdo;

FirebaseAuth auth;
FirebaseConfig config;

unsigned long sendDataPrevMillis = 0;
int count = 0;
bool signupOK = false;



LoRa_E32 e32ttl(&Serial);
//++++++++++++++++++++++++++++++
Adafruit_SSD1306 display(SCREEN_WIDTH, SCREEN_HEIGHT, &Wire);
//++++++++++++++++++++++++++++++
// Funcao display 
void display_init(void);
//++++++++++++++++++++++++++++++
//Funcao inicializa comunicacao com display Oled (Parametros: Nenhum - Retorno: Nenhum.
void display_init(void)
{
    if(!display.begin(SSD1306_SWITCHCAPVCC, OLED_ADDR)) 
    {
        Serial.println("Falha ao inicializar comunicacao com OLED");
        //Loop Infinito ate comunicar
                
    }
    else
    {
        Serial.println("Comunicacao com OLED inicializada com sucesso");
    
        // Limpa display e configura tamanho de fonte e cor 
        display.clearDisplay();
        display.setTextSize(1);
        display.setTextColor(WHITE);
    }
}

void WiFiConnection(){
    WiFi.mode(WIFI_STA);
    WiFiManager wm;
  
     bool res;
      // res = wm.autoConnect(); // auto generated AP name from chipid
      res = wm.autoConnect("S_MAP WIFI"); // anonymous ap
    //  res = wm.autoConnect("S_MAPWIFI","admim"); // password protected ap
  
      if(!res) {
          Serial.println("Failed to connect");
//ESP.restart();
      } 
      else {
          //if you get here you have connected to the WiFi    
          Serial.println("connected...yeey :)");
      }
}



const int ledPin1 = 2;
const int ledPin2 = 27;
const unsigned char logoespk8 [] PROGMEM = {
//Logo Espk8 128x64px
  0x00, 0x00, 0x00, 0x00, 0x00, 0x00, 0x00, 0x00, 0x00, 0x00, 0x00, 0x00, 0x00, 0x00, 0x00, 0x00, 
  0x00, 0x00, 0x00, 0x00, 0x00, 0x00, 0x00, 0x00, 0x00, 0x00, 0x00, 0x00, 0x00, 0x00, 0x00, 0x00, 
  0x00, 0x00, 0x01, 0xff, 0xff, 0xff, 0xff, 0xff, 0xff, 0xff, 0xff, 0xff, 0xf0, 0x00, 0x00, 0x00, 
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  0x00, 0x00, 0x00, 0x00, 0x00, 0x00, 0x00, 0x00, 0x00, 0x00, 0x00, 0x00, 0x00, 0x00, 0x00, 0x00
};

const unsigned char re1 [] PROGMEM = {
// 're1, 128x63px
  0xff, 0xff, 0xff, 0xff, 0xff, 0xff, 0xff, 0xff, 0xff, 0xff, 0xff, 0xff, 0xff, 0xff, 0xff, 0xff, 
  0xff, 0xff, 0xff, 0xff, 0xff, 0xff, 0xff, 0xff, 0xff, 0xff, 0xff, 0xff, 0xff, 0xff, 0xff, 0xff, 
  0xff, 0xff, 0xff, 0xff, 0xff, 0xff, 0xff, 0xff, 0xff, 0xff, 0xff, 0xff, 0xff, 0xff, 0xff, 0xff, 
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  0xff, 0xff, 0xff, 0xff, 0xff, 0xff, 0xff, 0xff, 0xff, 0xff, 0xff, 0xff, 0xff, 0xff, 0xff, 0xff
};

const unsigned char re2 [] PROGMEM = {
  // 're2, 128x63px
  0xff, 0xff, 0xff, 0xff, 0xff, 0xff, 0xff, 0xff, 0xff, 0xff, 0xff, 0xff, 0xff, 0xff, 0xff, 0xff, 
  0xff, 0xff, 0xff, 0xff, 0xff, 0xff, 0xff, 0xff, 0xff, 0xff, 0xff, 0xff, 0xff, 0xff, 0xff, 0xff, 
  0xff, 0xff, 0xff, 0xff, 0xff, 0xff, 0xff, 0xff, 0xff, 0xff, 0xff, 0xff, 0xff, 0xff, 0xff, 0xff, 
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  0xff, 0xff, 0xff, 0xff, 0xff, 0xff, 0xff, 0xff, 0xff, 0xff, 0xff, 0xff, 0xff, 0xff, 0xff, 0xff
};

const unsigned char re3 [] PROGMEM = {
  // 're3, 128x63px
  0xff, 0xff, 0xff, 0xff, 0xff, 0xff, 0xff, 0xff, 0xff, 0xff, 0xff, 0xff, 0xff, 0xff, 0xff, 0xff, 
  0xff, 0xff, 0xff, 0xff, 0xff, 0xff, 0xff, 0xff, 0xff, 0xff, 0xff, 0xff, 0xff, 0xff, 0xff, 0xff, 
  0xff, 0xff, 0xff, 0xff, 0xff, 0xff, 0xff, 0xff, 0xff, 0xff, 0xff, 0xff, 0xff, 0xff, 0xff, 0xff, 
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  0xff, 0xff, 0xff, 0xff, 0xff, 0xff, 0xff, 0xff, 0xff, 0xff, 0xff, 0xff, 0xff, 0xff, 0xff, 0xff
};  

const unsigned char re4 [] PROGMEM = {
  // 're4, 128x63px
  0xff, 0xff, 0xff, 0xff, 0xff, 0xff, 0xff, 0xff, 0xff, 0xff, 0xff, 0xff, 0xff, 0xff, 0xff, 0xff, 
  0xff, 0xff, 0xff, 0xff, 0xff, 0xff, 0xff, 0xff, 0xff, 0xff, 0xff, 0xff, 0xff, 0xff, 0xff, 0xff, 
  0xff, 0xff, 0xff, 0xff, 0xff, 0xff, 0xff, 0xff, 0xff, 0xff, 0xff, 0xff, 0xff, 0xff, 0xff, 0xff, 
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  0xff, 0xff, 0xff, 0xff, 0xff, 0xff, 0xff, 0xff, 0xff, 0xff, 0xff, 0xff, 0xff, 0xff, 0xff, 0xff
};
//++++++++++++++++++++++++++++++
void setup(){
  
   Serial.begin(9600);
   pinMode(ledPin1, OUTPUT);
   pinMode(ledPin2, OUTPUT);
  
  e32ttl.begin();
  Serial.println("Leitura Inicial");
 
 
//++++++++++++++++++++++++++++++++
   // Pinos do Display i2C  
    Wire.begin(OLED_SDA_PIN, OLED_SCL_PIN);
    // Inicia display
    display_init();
    display.clearDisplay();
    display.drawBitmap(0, 5, logoespk8 , 128, 64, 1);
    display.setTextColor(WHITE);
    display.setTextSize(1);
    display.setCursor(10,55);
    display.println("Agurarde...");
    display.display();
//++++++++++++++++++++++++++++++++++++++
    delay(100);

  WiFiConnection();
 /* Assign the api key (required) */
  config.api_key = API_KEY;

  /* Assign the RTDB URL (required) */
  config.database_url = DATABASE_URL;

  /* Sign up */
  if (Firebase.signUp(&config, &auth, "", "")){
    Serial.println("ok");
    signupOK = true;
  }
  else{
    Serial.printf("%s\n", config.signer.signupError.message.c_str());
  }

  /* Assign the callback function for the long running token generation task */
  config.token_status_callback = tokenStatusCallback; //see addons/TokenHelper.h
  
  Firebase.begin(&config, &auth);
  Firebase.reconnectWiFi(true);   
}
void loop() { 

 if (e32ttl.available() > 1) {
    ResponseContainer rs = e32ttl.receiveMessage();

   String message = rs.data;
   Serial.println(message);
   if (Firebase.ready() && signupOK && (millis() - sendDataPrevMillis > 15000 || sendDataPrevMillis == 0)){
    sendDataPrevMillis = millis();
    // Write an Int number on the database path test/int
    
    Serial.printf("Set string... %s\n", Firebase.setString(fbdo, F("/test/string"), message) ? "ok" : fbdo.errorReason().c_str());
   }
//++++++++++++++++++++++++++++++++++++++    
    if (message  == "cheio"){
    display.clearDisplay();
    display.drawBitmap(0, 0, re1 , 128, 64, 1);
    display.setTextSize(1);
    display.setTextColor(SSD1306_BLACK);
    display.setCursor(2, OLED_LINE1);
    display.print("NIVEL DO RESERVATORIO");
   
    display.display();

    digitalWrite(ledPin1, LOW);
    digitalWrite(ledPin2, HIGH);

    }
//++++++++++++++++++++++++++++++++++++++    
    if (message  == "inter") {
    display.clearDisplay();
    display.drawBitmap(0, 0, re2 , 128, 64, 1);
    display.setTextSize(1);
    display.setTextColor(SSD1306_BLACK);
    display.setCursor(2, OLED_LINE1);
    display.print("NIVEL DO RESERVATORIO");
   
    display.display();
       
    digitalWrite(ledPin1, LOW);
    digitalWrite(ledPin2, HIGH);

     } 
//++++++++++++++++++++++++++++++++++++++     
       if (message  == "med") { 
    
    display.clearDisplay();
    display.drawBitmap(0, 0, re3 , 128, 64, 1);
    display.setTextSize(1);
    display.setTextColor(SSD1306_BLACK);
    display.setCursor(2, OLED_LINE1);
    display.print("NIVEL DO RESERVATORIO");
    
    display.display();
  
    } 
       if (message  == "vaz") {
    
    display.clearDisplay();
    display.drawBitmap(0, 0, re4 , 128, 64, 1);
    display.setTextSize(1);
    display.setTextColor(SSD1306_BLACK);
    display.setCursor(2, OLED_LINE1);
    display.print("NIVEL DO RESERVATORIO");
    
    display.display();

    digitalWrite(ledPin1, HIGH);
    digitalWrite(ledPin2, LOW);

     } 

   }
//    wdt_reset();
}
